## components/assistant/Kconfig
```kconfig
menu "Voice Assistant"

    config ASSISTANT_WIFI_SSID
        string "WiFi SSID"
        default "MyNetwork"
        help
            SSID of the Wi-Fi network the D1001 will connect to.

    config ASSISTANT_WIFI_PASSWORD
        string "WiFi Password"
        default ""
        help
            Password for the Wi-Fi network.

    config ASSISTANT_WS_URI
        string "WebSocket URI"
        default "ws://192.168.1.100:8080/assistant"
        help
            URI of the NUC WebSocket server.

    config ASSISTANT_AUDIO_CHUNK_SIZE
        int "Audio chunk size (bytes)"
        default 4096
        help
            Size of each audio chunk sent over WebSocket.
            4096 bytes = 128ms of 16kHz 16-bit mono PCM.

    config ASSISTANT_RING_BUF_SIZE
        int "Playback ring buffer size (bytes)"
        default 65536
        help
            Size of the ring buffer for audio playback.
            Larger values smooth out network jitter. Allocated from PSRAM.

endmenu
```

## examples/voice_assistant/sdkconfig.defaults
```kconfig
# reTerminal D1001 Voice Assistant — default config
# Extend with: idf.py menuconfig → Voice Assistant

CONFIG_IDF_TARGET="esp32p4"
CONFIG_ESPTOOLPY_FLASHMODE_QIO=y
CONFIG_ESPTOOLPY_FLASHSIZE_16MB=y
CONFIG_PARTITION_TABLE_CUSTOM=y

# PSRAM (required for LVGL + audio buffers)
CONFIG_SPIRAM=y
CONFIG_SPIRAM_SPEED_200M=y
CONFIG_SPIRAM_USE_MALLOC=y
CONFIG_SPIRAM_MALLOC_ALWAYSINTERNAL=8192
CONFIG_SPIRAM_MALLOC_RESERVE_INTERNAL=32768
CONFIG_SPIRAM_TRY_ALLOCATE_WIFI_LWIP=y
CONFIG_SPIRAM_ALLOW_BSS_SEG_EXTERNAL_MEMORY=y

# Cache
CONFIG_CACHE_L2_CACHE_256KB=y
CONFIG_CACHE_L2_CACHE_LINE_128B=y

# Display
CONFIG_BSP_LCD_DPI_BUFFER_NUMS=2
CONFIG_BSP_DISPLAY_LVGL_AVOID_TEAR=y
CONFIG_BSP_DISPLAY_LVGL_DIRECT_MODE=y

# LVGL
CONFIG_LV_COLOR_SCREEN_TRANSP=y
CONFIG_LV_MEM_CUSTOM=y
CONFIG_LV_MEM_CUSTOM_INCLUDE="esp_heap_caps.h"
CONFIG_LV_FONT_MONTSERRAT_24=y
CONFIG_LV_FONT_MONTSERRAT_32=y

# Wi-Fi (ESP-Hosted SDIO to ESP32-C6)
CONFIG_ESP_HOST_WIFI_ENABLED=y
CONFIG_SLAVE_IDF_TARGET_ESP32C6=y
CONFIG_ESP_HOSTED_SDIO_GPIO_RESET_SLAVE=13
CONFIG_ESP_HOSTED_PRIV_SDIO_PIN_CLK_SLOT_1=11
CONFIG_ESP_HOSTED_PRIV_SDIO_PIN_CMD_SLOT_1=6
CONFIG_ESP_HOSTED_PRIV_SDIO_PIN_D0_SLOT_1=7
CONFIG_ESP_HOSTED_PRIV_SDIO_PIN_D1_4BIT_BUS_SLOT_1=8
CONFIG_ESP_HOSTED_PRIV_SDIO_PIN_D2_4BIT_BUS_SLOT_1=9
CONFIG_ESP_HOSTED_PRIV_SDIO_PIN_D3_4BIT_BUS_SLOT_1=10

# Console
CONFIG_ESP_CONSOLE_USB_SERIAL_JTAG=y

# System
CONFIG_ESP_SYSTEM_PANIC_PRINT_HALT=y
CONFIG_COMPILER_OPTIMIZATION_PERF=y

# Voice Assistant config (override with menuconfig)
CONFIG_ASSISTANT_WIFI_SSID="MyNetwork"
CONFIG_ASSISTANT_WIFI_PASSWORD=""
CONFIG_ASSISTANT_WS_URI="ws://192.168.1.100:8080/assistant"
```
